// These arguments were used when this file was generated. They will be automatically applied on subsequent loads 
// via the GUI or CLI invocations. Run CLI with '--help' for additional information on how to override these arguments.
// @cliArgs --board "/ti/boards/MSP_EXP432E401Y" --product "simplelink_msp432e4_sdk@3.30.00.22"
// @versions {"data":"2019020517","timestamp":"2019020517","tool":"1.0.655","templates":"2019020517"}

var Display = scripting.addModule("/ti/display/Display");
var DMA = scripting.addModule("/ti/drivers/DMA");
var GPIO = scripting.addModule("/ti/drivers/GPIO");
var RTOS = scripting.addModule("/ti/drivers/RTOS");
var Display1 = Display.addInstance();
var GPIO1 = GPIO.addInstance();
var GPIO2 = GPIO.addInstance();
var Board = scripting.addModule("/ti/drivers/Board");
var DriverLib = scripting.addModule("/ti/devices/DriverLib");
var Power = scripting.addModule("/ti/drivers/Power");
// name - Select the RTOS being used
RTOS.name = "FreeRTOS";
// Name - The C/C++ identifier used in applications as the index parameter passed to Display runtime APIs
Display1.$name = "CONFIG_Display_0";
// Use Hardware
Display1.$hardware = system.deviceData.board.components.XDS110UART;
// Name - The C/C++ identifier used in applications as the index parameter passed to UART runtime APIs
Display1.uart.$name = "CONFIG_UART_0";
// Name
Display1.uart.uart.$name = "MyUART1";
// Use Hardware
GPIO1.$hardware = system.deviceData.board.components.D1;
// Name - The C/C++ identifier used in applications as the index parameter passed to GPIO runtime APIs
GPIO1.$name = "CONFIG_GPIO_LED_0";
// Name - The C/C++ identifier used in applications as the index parameter passed to GPIO runtime APIs
GPIO2.$name = "CONFIG_GPIO_LED_1";
// Use Hardware
GPIO2.$hardware = system.deviceData.board.components.D2;
// Suggest solution
Display1.uart.uart.$suggestSolution = "UART0";
// Suggest solution
Display1.uart.uart.txPin.$suggestSolution = "34";
// Suggest solution
Display1.uart.uart.rxPin.$suggestSolution = "33";
// Suggest solution
GPIO1.gpioPin.$suggestSolution = "108";
// Suggest solution
GPIO2.gpioPin.$suggestSolution = "107";
